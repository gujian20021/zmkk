## config/west.yml
```yaml
manifest:
  remotes:
    - name: zmkfirmware
      url-base: https://github.com/zmkfirmware
    - name: cdc-mkb
      url-base: https://github.com/cdc-mkb
  projects:
    - name: zmk
      remote: cdc-mkb
      revision: mouse-pim447
      import: app/west.yml
  # projects:
  #   - name: zmk
  #     remote: zmkfirmware
  #     revision: main
  #     import: app/west.yml
  self:
    path: config
```
